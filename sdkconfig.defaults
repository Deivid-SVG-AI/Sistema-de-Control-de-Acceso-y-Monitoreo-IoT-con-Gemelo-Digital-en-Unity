## sdkconfig.defaults
```kconfig
# Enable custom partition table
CONFIG_PARTITION_TABLE_CUSTOM=y
CONFIG_PARTITION_TABLE_CUSTOM_FILENAME=\"partitions.csv\"
CONFIG_PARTITION_TABLE_OFFSET=0x8000
CONFIG_PARTITION_TABLE_MD5=y

# Ensure flash size matches 4MB physical device
CONFIG_ESPTOOLPY_FLASHSIZE_4MB=y

# SPIFFS basic settings (tune as needed)
CONFIG_SPIFFS_CACHE=y
CONFIG_SPIFFS_PAGE_SIZE=256
CONFIG_SPIFFS_OBJ_NAME_LEN=64
```
